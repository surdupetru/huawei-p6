## kernel/huawei/hwp6_u06/arch/arm/mach-k3v2/Kconfig
```kconfig
menu "Hisilicon K3 board feature"
	depends on ARCH_K3V2

# -------------------------------------
if ARCH_K3V2

comment "Hisilicon K3V200 options"

choice
	prompt "Select K3V200 processor family for target system"

config ARCH_K3V2_Hi362x_SOC
	bool "Hi362x family"
	select CPU_V7
	select ARM_GIC
	select MACH_K3V2OEM1
	select MIGHT_HAVE_PCI
	help
	  Support for Hisilicon K3V200 Hi362x processors, based on the
	  ARM CortexA9MP CPU and the ARM PL310 L2 cache controller

endchoice

# config MACH_TC45MSU3
#	bool "TC45MSU3 Board"
#	help
#	  Support for  Hisilicon TC45MSU3 FPGA Verify platform

config MACH_K3V2OEM1
	bool "K3V2OEM1 Board"
	select REGULATOR_HI6421
	help
	  Support for  Hisilicon K3V2 SOC OEM 1 platform

config MACH_K3V2OEM2
	bool "K3V2OEM2 Board"
	select REGULATOR_HI6421
	help
	  Support for  Hisilicon K3V2 SOC OEM 2 platform

comment "K3V200 features"
config K3_EDB_LEVEL
	int "Kernel Early-Debug Level( 0~254, 255 => Disable Early-Debug)"
	range 0 255
	default "0"
	help
	  Set the debug level of Early-Debug, low level will cause more debug message
# ADC driver

config IPPS_SUPPORT
	bool "IPPS driver support"
	select ARCH_HAS_CPUFREQ
	default y
	help
	  IPPS driver support for cpu gpu ddr dvfs.

config IPPS_PARAM_ALTERNATIVE
	bool "IPPS parameters seperate from firmware"
	default y
	help
	  IPPS parameters seperate from firmware.

config TRIM_VOL
	bool "TRIM Voltage support"
	default n
	help
	  TRIM Voltage patch support.

config S10_IPPS_FIRMWARE
	bool "S10 IPPS Firmware"
	depends on IPPS_SUPPORT
	default n
	help
	  S10 Special IPPS Firmware.

config MMC_EMMC_DEVICE
	bool "emmc device support"
	default y
	help
	  EMMC device support.

config MMC_SD_DEVICE
	bool "sd device support"
	default y
	help
	  SD device support.

config MMC_SDIO_DEVICE
	bool "sdio device support"
	default y
	help
	  SDIO device support.
config WIFI_DEVICE
	bool "bcm4330-wifi device support"
	select WIFI_CONTROL_FUNC
	default n
	help
	  bcm4330-wifi device support

config MODEM_BOOT
	bool "Modem boot control support"
	default y
	help
	  Modem boot control support

config XMM_POWER
	bool "xmm6260 power control support"
	depends on MODEM_BOOT
	default y
	help
	  xmm6260 power control

config XMM_RMNET
	bool "xmm6260 rmnet support"
	depends on XMM_POWER
	default y
	help
	  xmm6260 rmnet

config BALONG_POWER
	bool "balong boot control support"
	depends on MODEM_BOOT
	default y
	help
	  Modem balong boot control support

config BALONG_RMNET
	bool "balong rmnet support"
	depends on BALONG_POWER
	default y
	help
	  Modem balong rmnet config

config MODEM_BOOT_QSC6085
        bool "qsc6085 boot control support"
	depends on MODEM_BOOT
        default y
        help
          Modem qsc6085 boot control support

config MODEM_BOOT_MTK6252
	bool "mtk6252 boot control support"
	depends on MODEM_BOOT
	default y
	help
	  Modem mtk6252 boot control support

config MODEM_BOOT_SPRD8803G
       bool "sprd8803 boot control support"
       depends on MODEM_BOOT
       default y
       help
         Modem sprd8803 boot control support

config DEFAULT_TIMERCLK
	int "Kernel Timer Clock Frequence"
	default "26000000"
	help
	  Set default timer clock frequence

config CONNECTIVE_CONTROL_FPGA
	bool "connective platform select"
	default n
	help
	  Set connective platform

config LOWPM_DEBUG
	bool "low power debug property"
	depends on DEBUG_FS
	help
		set low power debug property

config DEBUG_LED
	bool "LED light for debug"
	default n
	help
		set LED light for debug

config K3_CLK_ALWAYS_ON
    tristate "k3v2 clk write register when disable clk"
	default n
	help
		Say y don't write register if disable CLK,used for debug

config K3V2_WAKEUP_TIMER
    tristate "k3v2 wakeup timer driver"
	default n
	help
		Say Y to enable k3v2 wakeup timer driver Support

config TOUCH_INPUT_SYNAPTICS2202
	bool "use synaptics 2202 for touch device"
	default n
	help
		set synaptics 2202 for TP else use synaptics 7020

config TOUCH_INPUT_SYNAPTICS_RMI4
	bool "use synaptics RMI4 for touch device"
	default n
	help
		Old synaptics TP, not use any more.If you want to use,disable TOUCH_INPUT_SYNAPTICS2202

config PMEM_ALTERNATIVES
    bool "Overrides PMEM sizes"
    default n

config PMEM_HIGPU_BUF_SIZE
    int "Overrides HIGPU_BUF_SIZE (in MB)"
    depends on PMEM_ALTERNATIVES
    default 0

config PMEM_GRALLOC_SIZE
    int "Overrides HISI_PMEM_GRALLOC_SIZE (in MB)"
    depends on PMEM_ALTERNATIVES
    default 0

config PMEM_CODEC_SIZE
    int "Overrides HISI_MEM_CODEC_SIZE (in MB)"
    depends on PMEM_ALTERNATIVES
    default 0

endif

config MAX_TTY_BUFFER
	int "MAX tty buffer"
	default "2097152"
	help
		Set the default max tty buffer sie 2M

config SUPPORT_B3750000_BITRATE
	bool "suport 3.75Mbps bitrate for uart"
	default y
	help
   	   slect this if use b3750000,pll frequency have change to 60Mhz

config ENABLE_K3V2_UART_SLEEP_CONTROL_FOR_D2
	bool "use additional gpio for uart sleep control"
	default y
	help
       slect this if use additional gpio for uart sleep control

config K3V2_RAMDUMP
	bool "ram dump for k3v2 platform"
	default y
	help
	ram dump for k3v2 platform

endmenu
```

## kernel/huawei/hwp6_u06/drivers/char/secengdev/Kconfig
```kconfig
#
# HARDWARE SEC ENG configuration
#

config SECENGDEV
	tristate "Hardware sec eng Core support"
	default y
	---help---
	  Hardware secengdev infrastructure.

	  To compile this driver as a module, choose M here: the
	  module will be called seceng.  This provides a device
	  that's usually called /dev/secengdev.

	  If unsure, say Y.
```

## kernel/huawei/hwp6_u06/drivers/hik3/8290enc/Kconfig
```kconfig
menu "8290 encode support"

config 8290_ENC
    depends on ANDROID_PMEM
    tristate "Support for hisi k3 video encode processor"
    help
        The encode device provides decode function for H.264/JPEG
endmenu
```

## kernel/huawei/hwp6_u06/drivers/hik3/Kconfig
```kconfig
menu "HIk3 support drivers"
source "drivers/hik3/g1dec/Kconfig"
source "drivers/hik3/8290enc/Kconfig"
endmenu
```

## kernel/huawei/hwp6_u06/drivers/hik3/g1dec/Kconfig
```kconfig
menu "g1 decode support"

config G1_DEC
    depends on ANDROID_PMEM
    tristate "Support for hisi k3 video dec processor"
    help
        The decode device provides decode function for H.264/MPEG4/VC1
endmenu
```

## kernel/huawei/hwp6_u06/drivers/huawei/Kconfig
```kconfig
menu "huawei linux device driver support package"

source "drivers/huawei/device/Kconfig"
endmenu
```

## kernel/huawei/hwp6_u06/drivers/huawei/device/Kconfig
```kconfig
#sensor unification for differ platform
menu "huawei linux device driver support package"

config HUAWEI_SENSORS_INPUT_INFO
	bool "huawei sensor input info"
	default n
	help
		get the huawei sensor input information.

config HUAWEI_TOUCH_INPUT_INFO
       bool "huawei touch input info"
       default y
       help
                get the huawei touch input information.

config TOUCHSCREEN_RMI4_SYNAPTICS_GENERIC
       default n
       bool "Synaptics RMI4 generic touchscreens"
       depends on I2C
       help
         Say Y here to enable support Synaptics RMI4
source "drivers/huawei/device/accelerometer/Kconfig"

source "drivers/huawei/device/compass/Kconfig"

source "drivers/huawei/device/light/Kconfig"

source "drivers/huawei/device/gyroscope/Kconfig"

source "drivers/huawei/device/touchscreen/Kconfig"

source "drivers/huawei/device/touchscreen_D2/Kconfig"

source "drivers/huawei/device/touchkey/Kconfig"

source "drivers/huawei/device/felica/Kconfig"

source "drivers/huawei/device/irda/Kconfig"

endmenu
```

## kernel/huawei/hwp6_u06/drivers/huawei/device/accelerometer/Kconfig
```kconfig
#
# accelerometer driver configuration
#

menuconfig INPUT_ACCELEROMETER
	bool "Accelerometer"
	select HUAWEI_SENSORS_INPUT_INFO
	default y
	help
		Say Y here, and a list of supported ACCELEROMETERs will be displayed.
		This option doesn't affect the kernel.



if INPUT_ACCELEROMETER


config HUAWEI_FEATURE_SENSORS_ACCELEROMETER_MMA8452
	tristate "FREESCALE MMA8452 accelerometer"
	select SERIO
	default y
	help
		Say Y here if you have the FREESCALE MMA8452 accelerometer.


config HUAWEI_FEATURE_SENSORS_ACCELEROMETER_ADI_ADXL346
	tristate "ADI ADXL346 accelerometer"
	select SERIO
	default y
	help
		Say Y here if you have the ADI ADXL346 accelerometer.


config HUAWEI_FEATURE_SENSORS_ACCELEROMETER_ST_LIS3XH
	tristate "ST LIS3DH and LIS331DLH accelerometer"
	select SERIO
	default y
	help
		Say Y here if you have the ST LIS3DH and LIS331DLH accelerometer.
config HUAWEI_FEATURE_SENSORS_ACC_COMPASS_LSM303D
	tristate "ST LSM303D accelerometer and magnetic"
	select SERIO
	default n
	help
		Say Y here if you have the ST LSM303D.
config HUAWEI_FEATURE_SENSORS_ACC_GYRO_LSM330
	tristate "ST LSM330 accelerometer and gyroscope"
	select SERIO
	default y
	help
		Say Y here if you have the ST LSM330.
config GSENSOR_DEBUG
	bool "gsensor debugging messages"
	default n
	help
		Say Y here if you want the gsensor to produce a bunch of debug
		messages to the system log.  Select this if you are having a
		problem with gsensor and want to see more of what is going on.

endif
```

## kernel/huawei/hwp6_u06/drivers/huawei/device/felica/Kconfig
```kconfig
menuconfig HUAWEI_KERNEL_FELICA_DEVICES
	bool "Near Field Communication (NFC) devices"
	default n

if HUAWEI_KERNEL_FELICA_DEVICES

source "drivers/huawei/device/felica/ak6921af/Kconfig"

source "drivers/huawei/device/felica/t6nd5/Kconfig"
      
endif # HUAWEI_KERNEL_FELICA_DEVICES
```

## kernel/huawei/hwp6_u06/drivers/huawei/device/felica/ak6921af/Kconfig
```kconfig
config HUAWEI_FEATURE_FELICA_AK6921AF
	tristate "AK6921AF FELICA driver"
	default n
```

## kernel/huawei/hwp6_u06/drivers/huawei/device/gyroscope/Kconfig
```kconfig
#
# gyroscope driver configuration
#
menuconfig INPUT_GYROSCOPE
	bool "gyroscope"
	select HUAWEI_SENSORS_INPUT_INFO
	default n
	help
		Say Y here, and a list of supported gyroscopes will be displayed.
		This option doesn't affect the kernel.



if INPUT_GYROSCOPE

config HUAWEI_FEATURE_GYROSCOPE_L3G4200DH
	tristate "L3G4200DH"
	default y
	help
		Say Y here if you have the ST L3G4200DH gyroscope.

config GYROSCOPE_DEBUG
	bool "gyroscope debugging messages"
	default n
	help
		Say Y here if you want the gyroscope to produce a bunch of debug
		messages to the system log.  Select this if you are having a
		problem with gyroscope and want to see more of what is going on.

endif
```

## kernel/huawei/hwp6_u06/drivers/huawei/device/irda/Kconfig
```kconfig
#
# irda sc16is7xx driver configuration
#
#menuconfig INPUT_IRDA
#	bool "irda"
#	select HUAWEI_SENSORS_INPUT_INFO
#	default n
#	help
#		Say Y here, and a list of supported irda will be displayed.
#		This option doesn't affect the kernel.



config HUAWEI_FEATURE_IRDA_SC16IS750
	tristate "sc16is750"
	default y
	help
	  If you say yes here you get support for sc16is750.
	
```

## kernel/huawei/hwp6_u06/drivers/huawei/device/light/Kconfig
```kconfig
#
# light sensor driver configuration
#
menuconfig INPUT_LIGHT_SENSOR
	bool "light sensor"
	select HUAWEI_SENSORS_INPUT_INFO
	default n
	help
		Say Y here, and a list of supported light sensors will be displayed.
		This option doesn't affect the kernel.


if INPUT_LIGHT_SENSOR

config HUAWEI_FEATURE_PROXIMITY_APDS990X
	tristate "apds990x"
	default y
	help
		If you say yes here you get support for light sensor apds990x.

config PROXIMITY_LIGHT_DEBUG
	bool "proximity and light debugging messages"
	default n
	help
		Say Y here if you want the proximity and the light to produce a bunch of debug
		messages to the system log.  Select this if you are having a
		problem with proximity or light and want to see more of what is going on.

config HUAWEI_FEATURE_CM3320
	tristate "cm3320"
	default y
	help
	  If you say yes here you get support for light sensor cm3320.
	
endif
```

## kernel/huawei/hwp6_u06/drivers/huawei/device/touchkey/Kconfig
```kconfig
#
# Input core configuration
#
config SYNAPTICS_TOUCH_KEY

    default y
	bool "Synaptics touchkey"
	help
	  Say Y here if you want to support the Synaptics RMI4 bus.
```

## kernel/huawei/hwp6_u06/drivers/k3gps/Kconfig
```kconfig
menu "GPS BCM 47511 Driver"   
                                             
comment "GPS BCM 47511 Driver"

config GPS_BCM_47511
        tristate "GPS Boardcom(47511) Driver Support"
        default n
        ---help---
	  Say Y here to compile support for gps devices into the kernel 
	  or say M to compile it as module.  
endmenu
```

## kernel/huawei/hwp6_u06/drivers/media/video/hik3/capture/Kconfig
```kconfig
if VIDEO_HIK3_CAMERA

menu "Hisilicon K3 sock Camera/V4L2 Features support"
config VIDEO_HIK3_ISP_CAMERA
	tristate "Hisilicon K3 ISP"
	depends on VIDEO_HIK3_CAMERA
	default m
    ---help---
        Hisilicon K3 ISP driver.

config HIK3_CAMERA_OV5642
    tristate "OV5642 camera"
    depends on VIDEO_HIK3_CAMERA && VIDEO_HIK3_ISP_CAMERA
    default n
    ---help---
        HiOV5642 camera driver

config HIK3_CAMERA_OV8830
    tristate "OV8830 camera"
    depends on VIDEO_HIK3_CAMERA && VIDEO_HIK3_ISP_CAMERA
    default n
    ---help---
        HiOV8830 camera driver

config HIK3_CAMERA_SONYIMX105
    tristate "SONYIMX105 camera"
    depends on VIDEO_HIK3_CAMERA && VIDEO_HIK3_ISP_CAMERA
    default n
    ---help---
        HiSONYIMX105 camera driver

config HIK3_CAMERA_S5K3H2YX_FOXCONN
    tristate "S5K3H2YX_FOXCONN camera"
    depends on VIDEO_HIK3_CAMERA && VIDEO_HIK3_ISP_CAMERA
    default n
    ---help---
        HiS5K3H2YX_FOXCONN camera driver

config HIK3_CAMERA_S5K3H2YX_SAMSUNGEM
    tristate "S5K3H2YX_SAMSUNGEM camera"
    depends on VIDEO_HIK3_CAMERA && VIDEO_HIK3_ISP_CAMERA
    default n
    ---help---
        HiS5K3H2YX_SAMSUNGEM camera driver

config HIK3_CAMERA_MT9M114
    tristate "MT9M114 camera"
    depends on VIDEO_HIK3_CAMERA && VIDEO_HIK3_ISP_CAMERA
    default n
    ---help---
        HiMT9M114 camera driver

config HIK3_CAMERA_FLASH
	tristate "Hisilicon K3 flash"
	depends on VIDEO_HIK3_CAMERA && VIDEO_HIK3_ISP_CAMERA
	default n
	---help---
	Hisilicon K3 flash driver

config CAMERA_FLASH_LM3642
	tristate "Hisilicon K3 flash"
	depends on HIK3_CAMERA_FLASH&&VIDEO_HIK3_CAMERA && VIDEO_HIK3_ISP_CAMERA
	default n
	---help---
	Hisilicon K3 flash driver

config HIK3_CAMERA_SONYIMX091
    tristate "SONYIMX091 camera"
    depends on VIDEO_HIK3_CAMERA && VIDEO_HIK3_ISP_CAMERA
    default n
    ---help---
        HiSONYIMX091 camera driver

config HIK3_CAMERA_S5K5CAG
    tristate "S5K5CAG camera"
    depends on VIDEO_HIK3_CAMERA && VIDEO_HIK3_ISP_CAMERA
    default n
    ---help---
        HiS5K5CAG camera driver

config HIK3_CAMERA_SONYIMX135
    tristate "SONYIMX135 camera"
    depends on VIDEO_HIK3_CAMERA && VIDEO_HIK3_ISP_CAMERA
    default n
    ---help---
        HiSONYIMX135 camera driver
	
config HIK3_CAMERA_SONYIMX188
    tristate "SONYIMX188 camera"
    depends on VIDEO_HIK3_CAMERA && VIDEO_HIK3_ISP_CAMERA
    default n
    ---help---
        HiSONYIMX188 camera driver
#endif
	
endmenu

endif

config HIK3_CAMERA_SONYIMX134
    tristate "SONYIMX134 camera"
    depends on VIDEO_HIK3_CAMERA && VIDEO_HIK3_ISP_CAMERA
    default n
    ---help---
        HiSONYIMX134 camera driver

config HIK3_CAMERA_HI542
    tristate "HI542 camera"
    depends on VIDEO_HIK3_CAMERA && VIDEO_HIK3_ISP_CAMERA
    default n
    ---help---
        HiHI542 camera driver


config HIK3_CAMERA_S5K4E1GA_FOXCONN
    tristate "S5K4E1GA_FOXCONN camera"
    depends on VIDEO_HIK3_CAMERA && VIDEO_HIK3_ISP_CAMERA
    default n
    ---help---
        HiS5K4E1GA_FOXCONN camera driver
```

## kernel/huawei/hwp6_u06/drivers/media/video/hik3/fake_capture/Kconfig
```kconfig
if VIDEO_HIK3_CAMERA

menu "Hisilicon K3 sock Camera/V4L2 Features support"
config VIDEO_HIK3_FAKE_CAMERA
	tristate "Hisilicon K3 FAKE CAMERA"
	depends on VIDEO_HIK3_CAMERA
	default m
    ---help---
        Hisilicon K3 Fake Camera driver.

endmenu

endif
```
