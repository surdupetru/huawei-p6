## kernel/huawei/hwp6_u06/drivers/misc/audience/Kconfig
```kconfig
config AUDIENCE
	tristate "Audience Voice Processor Driver"
	default y
	help
		Say Y to enable Audience Voice Processor Support
```

## kernel/huawei/hwp6_u06/drivers/misc/boardid/Kconfig
```kconfig
config BOARDID_DEV
    tristate "Boardid Virtual Device Driver"
	default y
	help
		Say Y to enable Boardid Virtual Device Support
```

## kernel/huawei/hwp6_u06/drivers/misc/gpu_drv/Kconfig
```kconfig
#test for V_GPU
menuconfig V_GPU
    bool "Vivante GPU Support"

if V_GPU

config G2D 
    bool "G2D Support"

config G3D 
    bool "G3D Support"

endif
```

## kernel/huawei/hwp6_u06/drivers/misc/hilog/Kconfig
```kconfig
menu "K3 log support"

config K3_LOG
    tristate "Support for hisi k3 log"
    help
		Support for Hisi K3 log
endmenu
```

## kernel/huawei/hwp6_u06/drivers/misc/modemctl/Kconfig
```kconfig
config MODEM_CONTROL
    tristate "Modem Contrl Driver"
	default y
	help
		Say Y to enable Modem Contrl Support
```

## kernel/huawei/hwp6_u06/drivers/misc/spk_5vboost/Kconfig
```kconfig
config SPK_5VBOOST
    tristate "5V BOOST SPK Driver"
	default y
	help
		Say Y to enable 5V BOOST Speaker
```

## kernel/huawei/hwp6_u06/drivers/misc/tfa9887/Kconfig
```kconfig
config TFA9887
	tristate "tfa9887 i2c driver"
	default y
	help
		Say Y to enable tfa9887 i2c driver support
```
